## main/Kconfig.projbuild
```kconfig
menu "MITS Peripheral Configuration"
    config LED_CONSOLE_COMMANDS
        bool "Enable LED Console commands"
        default y
        help
            Enable LED control from the console.

    config I2C_CONSOLE_COMMANDS
        bool "Enable I2C Console commands"
        default y
        help
            Enable I2C access from the console.
    config FS_CONSOLE_COMMANDS
        bool "Enable FS Console commands"
        default y
        help
            Enable FileSystem access from the console.
endmenu


menu "MITS Application Configuration"
    config MITS_APP
        bool "Enable MITS Application"
        default y
        help
            Enable the MITS application.
    config MITS_PRODUCTION
        bool "Enable MITS Production Application"
        default n
        help
            Enable the MITS application.
endmenu
```
